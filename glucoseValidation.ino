#include <TensorFlowLite_ESP32.h>

#include "mlp.h"
#include "tensorflow/lite/micro/all_ops_resolver.h"
#include "tensorflow/lite/micro/micro_error_reporter.h"
#include "tensorflow/lite/micro/micro_interpreter.h"
#include "tensorflow/lite/micro/system_setup.h"
#include "tensorflow/lite/schema/schema_generated.h"

// ---------------- TFLITE ----------------
constexpr int kTensorArenaSize = 80 * 1024;
uint8_t* tensor_arena = nullptr;

namespace {
const tflite::Model* model = nullptr;
tflite::MicroInterpreter* interpreter = nullptr;
TfLiteTensor* input = nullptr;
TfLiteTensor* output = nullptr;
bool model_ready = false;
}

// ---------------- SCALER ----------------
float standardmean[12] = {
  5.89823286e+01,6.09909094e+01,1.62605632e+02,1.32276955e-01,
  8.46512127e-01,8.17466526e+00,1.14323708e-03,8.23626750e-01,
  1.40552237e+00,2.93738234e+00,7.30682600e-02,4.24224828e-02
};

float standardscalar[12] = {
  1.50280021e+01,1.20265908e+01,9.72725743e+00,3.38791620e-01,
  1.67329459e-01,4.27028600e+00,7.47219046e-04,4.56709058e-01,
  2.93553816e-01,2.72568888e-01,3.55277456e-02,7.00136860e-02
};

// ---------------- INPUT DATA (FROM YOUR CSV) ----------------
const float input_data[100][12] = {
{77,67.5,160.2,0,0.6551818181818181,11.933197357447153,0.0009382611054101,0.4237790007505599,1.920990727076909,2.586104761259092,0.0498611167689186,0.0042920260487683},
{74,53,160.6,0,0.9368,12.8473654385559,0.0007425329260077,0.9858378971913114,1.51172305638998,2.4676450005134827,0.0508082971201351,0.0154194682139171},
{66,59.7,171,0,0.6965714285714285,1.2505958235217245,0.001331801419394,0.4503624330993218,1.5200838932400176,3.206176792610941,0.1025768010010427,0.0376608568151923},
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{50,80,178,0,1.0234285714285714,1.7728954955994092,0.0006010782236883,-0.0852113543500367,1.511569061618924,3.22685651903273,0.0567809987716129,0.2129794471256773}
};


// ---------------- ACTUAL GLUCOSE ----------------
const float actual_glucose[100] = {
154,108,79,103,165,108,83,153,100,89,130,114,108,136,103,115,116,121,129,97,117,112,94,
93,100,70,126,73,106,86,110,99,106,106,105,107,133,100,167,91,157,95,85,127,126,72,136,110,
86,135,78,80,183,115,95,96,94,103,98,116,89,92,124,117,109,112,205,99,86,84,94,114,93,106,
93,93,144,143,95,100,97,98,77,110,105,91,88,43,94,93,102,125,188,99,111,63,91,96,84,100
};

// ----------------CEGA MAPPING--------------------
char get_cega_zone(float r, float p) {
  // Zone A
  if ((r <= 70 && p <= 70) || (p >= 0.8 * r && p <= 1.2 * r)) {
    return 'A';
  }

  // Zone C
  if ((r > 130 && r <= 180 && p <= 1.4 * (r - 130)) ||
      (r > 70 && r <= 280 && p >= (r + 110))) {
    return 'C';
  }

  // Zone D
  if ((r <= 70 && p > 70 && p <= 180) ||
      (r >= 240 && p >= 70 && p <= 180)) {
    return 'D';
  }

  // Zone E
  if ((r <= 70 && p > 180) ||
      (r > 180 && p <= 70)) {
    return 'E';
  }

  // Zone B (default)
  return 'B';
}

// ---------------- SETUP ----------------
void setup() {
  Serial.begin(115200);
  delay(2000);

  tensor_arena = (uint8_t*)malloc(kTensorArenaSize);
  if (!tensor_arena) {
    Serial.println("Tensor arena allocation failed");
    return;
  }

  tflite::InitializeTarget();

  model = tflite::GetModel(model_weights_mlp_15s_vitaldb_int8_tflite);

  static tflite::AllOpsResolver resolver;
  static tflite::MicroErrorReporter micro_error_reporter;

  static tflite::MicroInterpreter static_interpreter(
      model, resolver, tensor_arena, kTensorArenaSize, &micro_error_reporter);

  interpreter = &static_interpreter;

  if (interpreter->AllocateTensors() != kTfLiteOk) {
    Serial.println("AllocateTensors failed");
    return;
  }

  input = interpreter->input(0);
  output = interpreter->output(0);

  model_ready = true;
}

// ---------------- LOOP ----------------
void loop() {
  if (!model_ready) return;

  float in_scale = input->params.scale;
  int in_zero_point = input->params.zero_point;

  float out_scale = output->params.scale;
  int out_zero_point = output->params.zero_point;

  Serial.println("\nRunning validation...\n");

  float total_error = 0;
  float total_percentage_error = 0;

  int zoneA = 0, zoneB = 0, zoneC = 0, zoneD = 0, zoneE = 0;

  for (int row = 0; row < 100; row++) {

    for (int i = 0; i < 12; i++) {
      int8_t quantized = (int8_t)(((input_data[row][i] - standardmean[i]) / standardscalar[i] / in_scale) + in_zero_point); // Full scalar test suite
      // quantized = (int8_t)(((input_data[row][i]) - standardmean[i]) / standardscalar[i]);                                   // No input scalers
      quantized = (int8_t)(input_data[row][i]);                                                                             // Raw data *OPTIMAL*
      // quantized = (int8_t)((input_data[row][i] / in_scale) + in_zero_point);                                                // No feature scale/mean
      input->data.int8[i] = quantized;
    }

    if (interpreter->Invoke() != kTfLiteOk) {
      Serial.println("Invoke failed");
      continue;
    }

    int8_t raw = output->data.int8[0];
    float predicted = (raw - out_zero_point) * out_scale;
    predicted = raw; // Used for raw input/outputs *OPTIMAL*

    float actual = actual_glucose[row];
    float error = abs(predicted - actual);
    total_error += error;

    // Avoid divide-by-zero
    if (actual != 0) {
      float pct_error = error / actual;
      total_percentage_error += pct_error;
    }

    char zone = get_cega_zone(actual, predicted);
    
    switch(zone) {
      case 'A': zoneA++; break;
      case 'B': zoneB++; break;
      case 'C': zoneC++; break;
      case 'D': zoneD++; break;
      case 'E': zoneE++; break;
    }

    Serial.print("Row ");
    Serial.print(row);
    Serial.print(" | Pred: ");
    Serial.print(predicted);
    Serial.print(" | Actual: ");
    Serial.print(actual);
    Serial.print(" | Error: ");
    Serial.println(error);

    delay(10);
  }

  float mae = total_error / 100.0;
  float mape = (total_percentage_error / 100.0) * 100.0;

  Serial.println("\n=================");
  Serial.print("MAE: ");
  Serial.println(mae);
  Serial.print("MAPE: ");
  Serial.println(mape);
  Serial.println("\n===== CEGA RESULTS =====");
  Serial.print("Zone A: ");
  Serial.print(zoneA);
  Serial.println("%");

  Serial.print("Zone B: ");
  Serial.print(zoneB);
  Serial.println("%");

  Serial.print("Zone C: ");
  Serial.print(zoneC);
  Serial.println("%");

  Serial.print("Zone D: ");
  Serial.print(zoneD);
  Serial.println("%");

  Serial.print("Zone E: ");
  Serial.print(zoneE);
  Serial.println("%");

  Serial.println("====================");

  while (true);
}